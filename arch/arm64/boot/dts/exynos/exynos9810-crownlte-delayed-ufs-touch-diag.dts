// SPDX-License-Identifier: GPL-2.0
/*
 * Touchscreen trial (q32): the delayed-UFS diagnostic plus the sec_ts Y771
 * touchscreen on PERIC0 USI03 HSI2C. Kept out of the base diag DTS: q32
 * showed the bootloader leaves LDO35/LDO43 off, so the IC does not answer
 * until a PMIC LDO-enable policy exists (Documentation/crownlte/touch-port.md).
 */
#include "exynos9810-crownlte-delayed-ufs-diag.dts"

&{/} {
	model = "Samsung Note9 delayed UFS diagnostic + touchscreen";
};

/*
 * Touchscreen stage 1 (sec_ts Y771 on PERIC0 USI03 HSI2C @0x48). Works only
 * if the bootloader left LDO35/LDO43 on; otherwise the driver logs and
 * stops. The only IC writes are SENSE_ON (0x10) and, if its default bits
 * are missing, SET_TOUCHFUNCTION (0x30). Self-test at ~109 s logs chip id,
 * firmware versions and the touch events seen since boot
 * ("touch selftest:").
 */
&usi_touch { status = "okay"; };
&hsi2c_touch { status = "okay"; };
&touchscreen {
	samsung,touch-selftest;
	status = "okay";
};
