// SPDX-License-Identifier: GPL-2.0
/*
 * Runtime C2 self-recovery (S0): the C2 quarantine marker page.
 *
 * One 4 KB no-map page holds the C2 quarantine record (v2: two alternating
 * sequenced slots, armed-session state, lost cores, consumed drills;
 * drivers/cpuidle/cpuidle-exynos9810.c), so the next boot of this kernel
 * keeps C2 off after a loss or an unclean end of an armed session instead
 * of looping. It sits in the last page of the 4.9 exynos-snapshot
 * carve-out (0xfda00000..0xff608000, already no-map here as
 * snapshot-after-pstore). 4.9 places no snapshot item there: its last item,
 * log_kevents, ends at 0xff518000. RAM only, nothing is written to storage.
 * See Documentation/crownlte/c2-runtime.md.
 *
 * Node paths, not labels: the flat ROM-in-RAM DTS has no labels.
 */

&{/reserved-memory/snapshot-after-pstore@fed18000} {
	reg = <0x0 0xfed18000 0x8ef000>;
};

&{/reserved-memory} {
	c2_quarantine: c2-quarantine@ff607000 {
		reg = <0x0 0xff607000 0x1000>;
		no-map;
	};
};

&{/soc@0/cpuidle@14070000} {
	memory-region = <&c2_quarantine>;
};
