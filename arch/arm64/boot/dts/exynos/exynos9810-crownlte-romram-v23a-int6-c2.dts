// SPDX-License-Identifier: GPL-2.0
/*
 * ROM-in-RAM integration 6 + runtime C2 stage S1a: C2 on the big cluster
 * (cpu4-7) from 45 s boot time, LITTLE stays WFI. Needs the S0 chain of
 * crownlte-c2-runtime (lost-core detector, watchdog stop-petting, quarantine
 * marker page, buddy hard-lockup panic). See Documentation/crownlte/c2-runtime.md.
 *
 * Build with rom-ram/src/build-dtb.sh (KSRC = this tree, KO = its build
 * directory).
 */
#include "exynos9810-crownlte-romram-v23a-int6.dts"
#include "exynos9810-crownlte-c2.dtsi"

&{/} {
	model = "Samsung Note9 ROM-in-RAM v23a integration 6 + big C2 (S1a)";
};

&{/soc@0/cpuidle@14070000} {
	samsung,c2-boot-cpus = <0xf0>;
	/* After the 40 s boot QoS release. */
	samsung,c2-arm-delay-ms = <45000>;
	/*
	 * Explicit clear without root (none on ROM-RAM): clears a TRUSTED
	 * quarantine record once, if the token is above the record's trial
	 * floor; the token then becomes the floor. One increasing sequence over
	 * all trial DTBs (c2-runtime.md section 6): a used or superseded token
	 * never clears again. On a missing or ambiguous record it clears
	 * nothing and only raises the floor: a new DTB with a higher token (or
	 * root) is needed then. 0xc251a001 (round 0/1) is retired.
	 */
	samsung,c2-quarantine-trial-token = <0xc2c20001>;
};
