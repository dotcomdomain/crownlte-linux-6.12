## drivers/devfreq/Kconfig
```kconfig
# SPDX-License-Identifier: GPL-2.0-only
menuconfig PM_DEVFREQ
	bool "Generic Dynamic Voltage and Frequency Scaling (DVFS) support"
	select PM_OPP
	help
	  A device may have a list of frequencies and voltages available.
	  devfreq, a generic DVFS framework can be registered for a device
	  in order to let the governor provided to devfreq choose an
	  operating frequency based on the device driver's policy.

	  Each device may have its own governor and policy. Devfreq can
	  reevaluate the device state periodically and/or based on the
	  notification to "nb", a notifier block, of devfreq.

	  Like some CPUs with CPUfreq, a device may have multiple clocks.
	  However, because the clock frequencies of a single device are
	  determined by the single device's state, an instance of devfreq
	  is attached to a single device and returns a "representative"
	  clock frequency of the device, which is also attached
	  to a device by 1-to-1. The device registering devfreq takes the
	  responsibility to "interpret" the representative frequency and
	  to set its every clock accordingly with the "target" callback
	  given to devfreq.

	  When OPP is used with the devfreq device, it is recommended to
	  register devfreq's nb to the OPP's notifier head.  If OPP is
	  used with the devfreq device, you may use OPP helper
	  functions defined in devfreq.h.

if PM_DEVFREQ

comment "DEVFREQ Governors"

config DEVFREQ_GOV_EXYNOS9810_INTERACTIVE
	bool "Exynos9810 QoS-only Interactive"
	depends on EXYNOS9810_BUS_TABLES
	help
	  Preserve the original QoS-only bus policy and delayed decreases with
	  immediate maximum-cap override. Use actual current-rate callbacks and
	  response-verified providers. This component performs no load polling
	  and does not register a bus provider or enable hardware nodes.



config DEVFREQ_GOV_SIMPLE_ONDEMAND
	tristate "Simple Ondemand"
	help
	  Chooses frequency based on the recent load on the device. Works
	  similar as ONDEMAND governor of CPUFREQ does. A device with
	  Simple-Ondemand should be able to provide busy/total counter
	  values that imply the usage rate. A device may provide tuned
	  values to the governor with data field at devfreq_add_device().

config DEVFREQ_GOV_PERFORMANCE
	tristate "Performance"
	help
	  Sets the frequency at the maximum available frequency.
	  This governor always returns UINT_MAX as frequency so that
	  the DEVFREQ framework returns the highest frequency available
	  at any time.

config DEVFREQ_GOV_POWERSAVE
	tristate "Powersave"
	help
	  Sets the frequency at the minimum available frequency.
	  This governor always returns 0 as frequency so that
	  the DEVFREQ framework returns the lowest frequency available
	  at any time.

config DEVFREQ_GOV_USERSPACE
	tristate "Userspace"
	help
	  Sets the frequency at the user specified one.
	  This governor returns the user configured frequency if there
	  has been an input to /sys/devices/.../userspace/set_freq.
	  Otherwise, the governor does not change the frequency
	  given at the initialization.

config DEVFREQ_GOV_PASSIVE
	tristate "Passive"
	help
	  Sets the frequency based on the frequency of its parent devfreq
	  device. This governor does not change the frequency by itself
	  through sysfs entries. The passive governor recommends that
	  devfreq device uses the OPP table to get the frequency/voltage.

comment "DEVFREQ Drivers"

config EXYNOS9810_BUS_GUARDS
	bool "Exynos9810 durable dependency guard ownership"
	depends on EXYNOS9810_BUS_TABLES
	help
	  Own bounded built-in dependency requests independently of consumer
	  lifetime. Keep a supported maximum floor after failed consumer probe
	  or removal, and verify actual supplier updates. This cannot bypass a
	  thermal cap or prove firmware/hardware coordination by itself.

config EXYNOS9810_BUS_TRANSITIONS
	bool "Exynos9810 shared real bus frequency transitions"
	select EXYNOS9810_BUS_GUARDS
	depends on EXYNOS9810_MIF_BTS
	help
	  Perform real MIF, INT and FSYS0 CAL rate transitions with verified
	  mandatory dependency floors and actual BTS writes. Retain protective
	  requests and report errors when firmware acknowledgments are uncertain.
	  Provider/governor registration and PM lifecycle handling remain separate
	  required work. This component does not enable hardware nodes.



config EXYNOS9810_MIF_BTS
	bool "Exynos9810 mandatory MIF BTS SNode hardware service"
	depends on EXYNOS9810_BUS_TABLES && OF
	help
	  Map and verify all four original MIF traffic-control register banks.
	  Expose a mandatory managed supplier with explicit transition errors
	  and restore register state before dependent devices resume.
	  The MIF devfreq provider and full BTS bandwidth/scenario support
	  still need implementation. No enabled hardware node is added.



config EXYNOS9810_BUS_PROVIDERS
	bool "Exynos9810 calibrated MIF/INT/FSYS0 devfreq providers"
	depends on EXYNOS9810_BUS_TRANSITIONS && EXYNOS9810_MIF_BTS
	select DEVFREQ_GOV_EXYNOS9810_INTERACTIVE
	select EXYNOS9810_LEGACY_BUS_QOS
	help
	  Register real calibrated bus providers, supplier links and original
	  kHz sysfs controls. Retain bootstrap requests until all buses bind.
	  Board nodes remain disabled pending complete PM, thermal and BTS
	  validation. This option alone does not enable hardware nodes.

config EXYNOS9810_BUS_TABLES
	bool "Exynos9810 CAL/ECT bus table and FVP protocol component"
	depends on ARCH_EXYNOS && EXYNOS9810_LEGACY_CAL && EXYNOS_ACPM && ECT
	help
	  Validate actual calibrated bus levels, exact ECT dependency rows and
	  prepare the original response-enabled MIF constraint protocol.
	  This does not register a bus devfreq provider or enable hardware nodes.
	  Real BTS, thermal and supplier transitions remain required.

config EXYNOS9810_LEGACY_BUS_QOS
	bool "Exynos9810 original MIF/INT/FSYS0 QoS character ABI"
	depends on EXYNOS9810_BUS_TABLES && PM
	help
	  Preserve the original six bus minimum/maximum character interfaces,
	  binary and hexadecimal input, signed aggregate kHz reads and early
	  requests. Bridge them to real registered devfreq providers.
	  Other QoS domains and full thermal coordination remain required.



config ARM_EXYNOS_BUS_DEVFREQ
	tristate "ARM Exynos Generic Memory Bus DEVFREQ Driver"
	depends on ARCH_EXYNOS || COMPILE_TEST
	select DEVFREQ_GOV_SIMPLE_ONDEMAND
	select DEVFREQ_GOV_PASSIVE
	select DEVFREQ_EVENT_EXYNOS_PPMU
	select PM_DEVFREQ_EVENT
	help
	  This adds the common DEVFREQ driver for Exynos Memory bus. Exynos
	  Memory bus has one more group of memory bus (e.g, MIF and INT block).
	  Each memory bus group could contain many memoby bus block. It reads
	  PPMU counters of memory controllers by using DEVFREQ-event device
	  and adjusts the operating frequencies and voltages with OPP support.
	  This does not yet operate with optimal voltages.

config ARM_IMX_BUS_DEVFREQ
	tristate "i.MX Generic Bus DEVFREQ Driver"
	depends on ARCH_MXC || COMPILE_TEST
	select DEVFREQ_GOV_USERSPACE
	help
	  This adds the generic DEVFREQ driver for i.MX interconnects. It
	  allows adjusting NIC/NOC frequency.

config ARM_IMX8M_DDRC_DEVFREQ
	tristate "i.MX8M DDRC DEVFREQ Driver"
	depends on (ARCH_MXC && HAVE_ARM_SMCCC) || \
		(COMPILE_TEST && HAVE_ARM_SMCCC)
	select DEVFREQ_GOV_USERSPACE
	help
	  This adds the DEVFREQ driver for the i.MX8M DDR Controller. It allows
	  adjusting DRAM frequency.

config ARM_TEGRA_DEVFREQ
	tristate "NVIDIA Tegra30/114/124/210 DEVFREQ Driver"
	depends on ARCH_TEGRA_3x_SOC || ARCH_TEGRA_114_SOC || \
		ARCH_TEGRA_132_SOC || ARCH_TEGRA_124_SOC || \
		ARCH_TEGRA_210_SOC || \
		COMPILE_TEST
	depends on COMMON_CLK
	help
	  This adds the DEVFREQ driver for the Tegra family of SoCs.
	  It reads ACTMON counters of memory controllers and adjusts the
	  operating frequencies and voltages with OPP support.

config ARM_MEDIATEK_CCI_DEVFREQ
	tristate "MEDIATEK CCI DEVFREQ Driver"
	depends on ARM_MEDIATEK_CPUFREQ || COMPILE_TEST
	select DEVFREQ_GOV_PASSIVE
	help
	  This adds a devfreq driver for MediaTek Cache Coherent Interconnect
	  which is shared the same regulators with the cpu cluster. It can track
	  buck voltages and update a proper CCI frequency. Use the notification
	  to get the regulator status.

config ARM_RK3399_DMC_DEVFREQ
	tristate "ARM RK3399 DMC DEVFREQ Driver"
	depends on (ARCH_ROCKCHIP && HAVE_ARM_SMCCC) || \
		(COMPILE_TEST && HAVE_ARM_SMCCC)
	select DEVFREQ_EVENT_ROCKCHIP_DFI
	select DEVFREQ_GOV_SIMPLE_ONDEMAND
	select PM_DEVFREQ_EVENT
	help
	  This adds the DEVFREQ driver for the RK3399 DMC(Dynamic Memory Controller).
	  It sets the frequency for the memory controller and reads the usage counts
	  from hardware.

config ARM_SUN8I_A33_MBUS_DEVFREQ
	tristate "sun8i/sun50i MBUS DEVFREQ Driver"
	depends on ARCH_SUNXI || COMPILE_TEST
	depends on COMMON_CLK
	select DEVFREQ_GOV_SIMPLE_ONDEMAND
	help
	  This adds the DEVFREQ driver for the MBUS controller in some
	  Allwinner sun8i (A33 through H3) and sun50i (A64 and H5) SoCs.

source "drivers/devfreq/event/Kconfig"

endif # PM_DEVFREQ
```

## drivers/gud/gud-exynos9810/sec-os-ctrl/Kconfig
```kconfig
#
# Secure OS control configuration
#
config SECURE_OS_CONTROL
	bool "Secure OS control"
	depends on TRUSTONIC_TEE && SECURE_OS_BOOSTER_API
	help
	  Enable Secure OS control sysfs.
	  It can migrate a core that executes secure OS tasks
	  and check a current core on secure OS.
```

## drivers/net/wireless/bcmdhd_101_16/Kconfig
```kconfig
# SPDX-License-Identifier: GPL-2.0
#
# Samsung bcmdhd 101.16 for the Galaxy Note9 (crownlte) on 6.12.
# Trimmed from the 4.9 Kconfig: only the BCM4361/PCIe symbols that the
# crownlte 4.9 build used are kept, with the same names and defaults,
# because the Kbuild file and the sources test them.
#

config BROADCOM_WIFI
	bool "Broadcom DHD Wi-Fi driver (Samsung bcmdhd 101.16)"
	depends on WLAN && CFG80211=y && OF
	help
	  Samsung's Broadcom DHD driver as used by the crownlte 4.9 kernel.
	  The Lineage Wi-Fi HAL on /vendor talks to this driver through
	  nl80211 vendor commands, Android private commands and /sys/wifi,
	  not to brcmfmac. Built in only: the HAL expects /sys/module/dhd.

config BCM4361
	bool "Broadcom BCM4361 PCIe (crownlte)"
	depends on BROADCOM_WIFI && PCI && PCIE_EXYNOS9810
	select FW_LOADER
	help
	  BCM4361 on Exynos 9810 PCIe channel 0. Nothing happens unless the
	  samsung,brcm-wlan DT node is enabled.
	  See Documentation/crownlte/wifi-port.md.

config BCMDHD_PCIE
	def_bool y
	depends on BCM4361

config BCMDHD_FW_PATH
	string "Firmware path"
	depends on BROADCOM_WIFI
	default "/etc/wifi/bcmdhd_sta.bin"

config BCMDHD_NVRAM_PATH
	string "NVRAM path"
	depends on BROADCOM_WIFI
	default "/etc/wifi/nvram_net.txt"

config BROADCOM_WIFI_RESERVED_MEM
	bool "Preallocated memory for the Wi-Fi driver"
	depends on BROADCOM_WIFI
	default y

config BCMDHD_PREALLOC_MEMDUMP
	bool "Preallocated dongle memory dump buffer"
	depends on BROADCOM_WIFI_RESERVED_MEM
	default y

config BCMDHD_OOB_HOST_WAKE
	bool "Use the external WLAN_HOST_WAKE pin"
	depends on BROADCOM_WIFI
	default y

config BCMDHD_GET_OOB_STATE
	bool "Report the WLAN_HOST_WAKE pin level"
	depends on BCMDHD_OOB_HOST_WAKE
	default y

config WLAN_REGION_CODE
	int "Region code for Broadcom Wi-Fi featured functions"
	depends on BROADCOM_WIFI
	default 100

config WLAIBSS
	bool "Advanced IBSS mode"
	depends on BCM4361
	default y

config WL_RELMCAST
	bool "Reliable Multicast Support"
	depends on BCM4361
	default y
```
