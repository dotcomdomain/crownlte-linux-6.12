## drivers/soc/samsung/Kconfig
```kconfig
# SPDX-License-Identifier: GPL-2.0
#
# Samsung SoC drivers
#
menuconfig SOC_SAMSUNG
	bool "Samsung SoC driver support" if COMPILE_TEST

if SOC_SAMSUNG

# There is no need to enable these drivers for ARMv8
config EXYNOS_ASV_ARM
	bool "Exynos ASV ARMv7-specific driver extensions" if COMPILE_TEST
	depends on EXYNOS_CHIPID

config EXYNOS_CHIPID
	tristate "Exynos ChipID controller and ASV driver"
	depends on ARCH_EXYNOS || COMPILE_TEST
	default ARCH_EXYNOS
	select EXYNOS_ASV_ARM if ARM && ARCH_EXYNOS
	select MFD_SYSCON
	select SOC_BUS
	help
	  Support for Samsung Exynos SoC ChipID and Adaptive Supply Voltage.
	  This driver can also be built as module (exynos_chipid).

config EXYNOS_USI
	tristate "Exynos USI (Universal Serial Interface) driver"
	default ARCH_EXYNOS && ARM64
	depends on ARCH_EXYNOS || COMPILE_TEST
	select MFD_SYSCON
	help
	  Enable support for USI block. USI (Universal Serial Interface) is an
	  IP-core found in modern Samsung Exynos SoCs, like Exynos850 and
	  ExynosAutoV9. USI block can be configured to provide one of the
	  following serial protocols: UART, SPI or High Speed I2C.

	  This driver allows one to configure USI for desired protocol, which
	  is usually done in USI node in Device Tree.

config EXYNOS_PMU
	bool "Exynos PMU controller driver" if COMPILE_TEST
	depends on ARCH_EXYNOS || ((ARM || ARM64) && COMPILE_TEST)
	select EXYNOS_PMU_ARM_DRIVERS if ARM && ARCH_EXYNOS
	select MFD_CORE
	select REGMAP_MMIO

# There is no need to enable these drivers for ARMv8
config EXYNOS_PMU_ARM_DRIVERS
	bool "Exynos PMU ARMv7-specific driver extensions" if COMPILE_TEST
	depends on EXYNOS_PMU

config SAMSUNG_PM_CHECK
	bool "S3C2410 PM Suspend Memory CRC"
	depends on PM && (ARCH_S3C64XX || ARCH_S5PV210)
	select CRC32
	help
	  Enable the PM code's memory area checksum over sleep. This option
	  will generate CRCs of all blocks of memory, and store them before
	  going to sleep. The blocks are then checked on resume for any
	  errors.

	  Note, this can take several seconds depending on memory size
	  and CPU speed.

config SAMSUNG_PM_CHECK_CHUNKSIZE
	int "S3C2410 PM Suspend CRC Chunksize (KiB)"
	depends on PM && SAMSUNG_PM_CHECK
	default 64
	help
	  Set the chunksize in Kilobytes of the CRC for checking memory
	  corruption over suspend and resume. A smaller value will mean that
	  the CRC data block will take more memory, but will identify any
	  faults with better precision.

config EXYNOS_REGULATOR_COUPLER
	bool "Exynos SoC Regulator Coupler" if COMPILE_TEST
	depends on ARCH_EXYNOS || COMPILE_TEST
endif

config EXYNOS9810_DIAGNOSTIC
	bool "Exynos9810 diagnostic clock gates"
	depends on ARCH_EXYNOS && ARM64 && OF
	help
	  Optional explicit clock gate MMIO for early bring-up, activated only
	  when the board supplies a s9p,clock-gates device tree node.

config EXYNOS9810_DIAGNOSTIC_MUIC
	bool "Exynos9810 diagnostic MAX77705 USB path switch"
	depends on ARCH_EXYNOS && I2C
	help
	  Source-only diagnostic helper for the Note9 MAX77705 Type-C MCU.
	  Applies the vendor D+/D- path opcode; not the Android MUIC ABI.

config EXYNOS9810_LEGACY_CAL
	bool "Exynos9810 original CAL, ASV and ACPM clock foundation"
	depends on ARCH_EXYNOS && ARM64 && OF && COMMON_CLK
	select PM
	select CAL_IF
	select CMUCAL
	select CMU_EWF
	select PMUCAL
	select FLEXPMU
	select CP_PMUCAL
	select ACPM_DVFS
	select EXYNOS_ACPM
	select ECT
	select SOC_EXYNOS9810
	help
	  Compile the original crownlte hardware clock tables and real firmware
	  transport. Board nodes must remain disabled until bring-up validation.
	  CPU/devfreq thermal policy and vendor power domains need further work.

config CAL_IF
	bool
config CMUCAL
	bool
config PMUCAL
	bool
config FLEXPMU
	bool
config CP_PMUCAL
	bool
config ACPM_DVFS
	bool
config EXYNOS_ACPM
	bool
config ECT
	bool
config SOC_EXYNOS9810
	bool

config CMUCAL_QCH_IGNORE_SUPPORT
	bool
	default y if EXYNOS9810_LEGACY_CAL

config CMU_EWF
	bool

config EXYNOS9810_DIAGNOSTIC_RESTART
	bool "Checked crownlte diagnostic restart only"
	depends on EXYNOS9810_LEGACY_CAL && OF && ARM64
	help
	  Experimental no-storage diagnostic return using the original Samsung
	  normal boot reasons, bounded ACPM STOP and original DFD reset masks.
	  Only the explicit crownlte diagnostic restart DT compatible activates
	  this handler. Failed prerequisites refuse reset and require physical
	  fallback. Hardware reset and bootloader reason handling are unproven.

config EXYNOS9810_DIAGNOSTIC_ORIGINAL_RESET
	bool "Experimental original-style crownlte diagnostic reset"
	depends on EXYNOS9810_DIAGNOSTIC_RESTART
	default n
	help
	  Diagnostic-only experiment for the explicit crownlte no-storage DT.
	  Keep checked normal INFORM reasons, CAL revision, topology and DFD
	  preparation. Attempt bounded ACPM STOP only when its supplier is owned
	  and ready, then permit checked PMU SWRESET despite unavailable or failed
	  STOP, matching the original 4.9 best-effort reset policy.
	  This may fail to reset or return. Manual Download Mode restore and an
	  available owner are still required. Never enable for Android production.
```

## drivers/staging/android/Kconfig
```kconfig
# SPDX-License-Identifier: GPL-2.0
config ASHMEM
	bool "Enable the Anonymous Shared Memory Subsystem"
	depends on SHMEM && RUST
	help
	  The ashmem subsystem is a new shared memory allocator, similar to
	  POSIX SHM but with different behavior and sporting a simpler
	  file-based API.

	  It is, in theory, a good memory allocator for low-memory devices,
	  because it can discard shared memory units when under memory pressure.

config ASHMEM_C
	bool "Anonymous Shared Memory Subsystem (C driver, no Rust)"
	depends on SHMEM && !ASHMEM
	help
	  The C ashmem driver (mainline staging up to v5.18, Android Common
	  Kernels up to android15-6.6), ported to this kernel for builds
	  without a Rust toolchain. It provides /dev/ashmem with the ashmem
	  ioctl ABI, including ASHMEM_GET_FILE_ID. The ashmem ioctls on memfd
	  files are not provided, so the Android libcutils keeps using
	  /dev/ashmem.

	  Say Y for Android userspace on a kernel without CONFIG_RUST.
```

## drivers/thermal/samsung/Kconfig
```kconfig
# SPDX-License-Identifier: GPL-2.0-only
config EXYNOS_THERMAL
	tristate "Exynos thermal management unit driver"
	depends on THERMAL_OF
	depends on HAS_IOMEM
	help
	  If you say yes here you get support for the TMU (Thermal Management
	  Unit) driver for Samsung Exynos series of SoCs. This driver initialises
	  the TMU, reports temperature and handles cooling action if defined.
	  This driver uses the Exynos core thermal APIs and TMU configuration
	  data from the supported SoCs.

config EXYNOS9810_ACPM_TMU
	bool "Exynos 9810 TMU temperatures through the ACPM TMU plugin"
	depends on EXYNOS_ACPM && THERMAL_OF && HAS_IOMEM
	depends on SOC_EXYNOS9810 || COMPILE_TEST
	help
	  Reports Exynos 9810 TMU temperatures as OF thermal sensors by
	  asking the ACPM TMU plugin (Samsung 4.9 exynos_acpm_tmu protocol,
	  TMU_IPC_INIT/TMU_IPC_READ_TEMP). It never programs TMU registers;
	  it logs the bootloader's hardware-trip state at probe.

	  When the boot leaves the plugin detached, the ACPM framework loads
	  it from a "dynamic-plugins" DT entry; build the image in with
	  CONFIG_EXTRA_FIRMWARE="exynos9810_acpm_tmu.fw" and
	  CONFIG_EXTRA_FIRMWARE_DIR="firmware".
```

## drivers/video/fbdev/exynos/Kconfig
```kconfig
# SPDX-License-Identifier: GPL-2.0-only
#
# Samsung Exynos display (fbdev)
#

config FB_EXYNOS9810_DECON_HANDOVER
	bool "Exynos9810 DECON-F boot scanout handover (simplefb helper)"
	depends on ARCH_EXYNOS || COMPILE_TEST
	depends on FB_SIMPLE=y && OF && MFD_SYSCON
	select FONT_SUPPORT
	help
	  Helper for a simple-framebuffer that points at the buffer the
	  Exynos9810 bootloader (Galaxy S9/Note9 SBoot) leaves DECON-F
	  scanning out. It reads and logs the DECON/DPP state, and when the
	  device tree asks for it, enables the DECON TE trigger so that a
	  MIPI command-mode panel receives the new frame contents. It can
	  also draw a delayed on-screen self-test pattern.

	  It never changes clocks, power, panel or timing settings.

source "drivers/video/fbdev/exynos/dpu_9810/Kconfig"
```

## drivers/video/fbdev/exynos/dpu_9810/Kconfig
```kconfig
# SPDX-License-Identifier: GPL-2.0-only

config FB_EXYNOS9810_DPU
	bool "Exynos9810 DPU (DECON-F/DPP) fbdev driver, adopt mode"
	depends on FB && OF && ARM64 && MFD_SYSCON
	depends on ARCH_EXYNOS || COMPILE_TEST
	select FB_IOMEM_HELPERS
	select APERTURE_HELPERS
	select DMA_SHARED_BUFFER
	select SYNC_FILE
	select FONT_SUPPORT
	select CRC32
	help
	  Port of the Samsung 4.9 dpu_9810 DECON-F fbdev driver for the
	  Exynos9810 (Galaxy S9/Note9). It adopts the display state left by
	  the bootloader (DECON, DSIM and panel keep running untouched),
	  registers /dev/graphics/fb0 with the ioctl ABI of the vendor HWC,
	  vsync from the panel TE line, and applies window configurations
	  through the DPP channels for physically contiguous buffers.
	  It does not control panel power, clocks or timing.
	  Opt-in by device tree, it can send the one S6E3HA8 brightness
	  sequence the owner's 4.9 kernel uses (44700) through DSIM0.
	  See Documentation/crownlte/display-port.md and
	  Documentation/crownlte/panel-brightness.md.

config FB_EXYNOS9810_PANEL_RO
	bool "Read-only \"panel\" backlight for the Galaxy Note9"
	depends on OF && BACKLIGHT_CLASS_DEVICE=y
	help
	  Registers the backlight class device "panel" that the vendor
	  light HAL expects, mirroring the bootloader brightness and refusing
	  changes until the S6E3HA8 panel driver is ported.
```
